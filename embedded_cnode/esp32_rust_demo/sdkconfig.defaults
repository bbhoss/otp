## embedded_cnode/esp32_rust_demo/sdkconfig.defaults
```kconfig
# ESP32 specific settings
CONFIG_IDF_TARGET="esp32"

# Enable console output
CONFIG_ESP_CONSOLE_UART_DEFAULT=y

# Stack size
CONFIG_ESP_MAIN_TASK_STACK_SIZE=16384

# Enable std support
CONFIG_COMPILER_CXX_EXCEPTIONS=y

# QEMU OpenCores Ethernet support
CONFIG_ETH_USE_OPENETH=y
CONFIG_ETH_OPENETH_DMA_RX_BUFFER_NUM=3
CONFIG_ETH_OPENETH_DMA_TX_BUFFER_NUM=3

# LWIP configuration
CONFIG_LWIP_ENABLE=y
CONFIG_LWIP_MAX_SOCKETS=10
CONFIG_LWIP_SO_REUSE=y
CONFIG_LWIP_SO_REUSE_RXTOALL=y
CONFIG_ESP_NETIF_TCPIP_LWIP=y

# VFS support
CONFIG_VFS_SUPPORT_IO=y
CONFIG_VFS_SUPPORT_SELECT=y

# Disable hardware acceleration (not supported in QEMU)
CONFIG_MBEDTLS_HARDWARE_AES=n
CONFIG_MBEDTLS_HARDWARE_SHA=n
```

## lib/erl_interface/examples/esp32_rust_app/sdkconfig.defaults
```kconfig
# ESP32 specific settings
CONFIG_IDF_TARGET="esp32"

# Enable console output
CONFIG_ESP_CONSOLE_UART_DEFAULT=y

# Stack size
CONFIG_ESP_MAIN_TASK_STACK_SIZE=16384

# Enable LWIP for networking
CONFIG_LWIP_SO_RCVBUF=y

# Enable std support
CONFIG_COMPILER_CXX_EXCEPTIONS=y
```
